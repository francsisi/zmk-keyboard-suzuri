## boards/shields/suzuri/Kconfig.defconfig
```kconfig
if SHIELD_SUZURI

    config ZMK_KEYBOARD_NAME
        default "SUZURI"

    config INPUT
        bool
        default y

    config PMW3610
        bool
        default y

    config SPI
        bool
        default y

    config ZMK_BLE
        bool
        default y

    config ZMK_POINTING
        bool
        default y

endif
```
